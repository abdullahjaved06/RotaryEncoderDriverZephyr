## build/Kconfig/Kconfig.sysbuild.modules
```kconfig
menu "nrf (/home/abdullah/ncs/v2.5.0/nrf)"
osource "/home/abdullah/ncs/v2.5.0/nrf/sysbuild/Kconfig.sysbuild"
config ZEPHYR_NRF_MODULE
	bool
	default y
endmenu
```
